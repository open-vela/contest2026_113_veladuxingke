## app/lan_panel/Kconfig
```kconfig
#
# Contest 2026 team 113 LAN panel
#

menuconfig CONTEST2026_113_LAN_PANEL
	bool "Contest 2026 team 113 LAN panel"
	default n
	depends on NET
	depends on NET_TCP
	depends on NETUTILS_NETLIB
	---help---
		Enable the bounded, concurrent LAN status and configuration panel.

if CONTEST2026_113_LAN_PANEL

config CONTEST2026_113_LAN_PANEL_PRIORITY
	int "LAN panel task priority"
	default 100

config CONTEST2026_113_LAN_PANEL_STACKSIZE
	int "LAN panel task stack size"
	default 32768

config CONTEST2026_113_LAN_PANEL_PORT
	int "LAN panel TCP port"
	range 1 65535
	default 8080

config CONTEST2026_113_LAN_PANEL_TIMEOUT_SEC
	int "LAN panel socket timeout"
	range 1 60
	default 5

config CONTEST2026_113_LAN_PANEL_MAX_REQUEST
	int "LAN panel maximum request bytes"
	range 512 8192
	default 4096

config CONTEST2026_113_LAN_PANEL_KWS_EXPORT
	bool "Read-only KWS corpus export"
	default y
	depends on FS_FAT
	depends on CONTEST2026_113_ROUTINE_MANAGER
	---help---
		Expose authenticated, exact-path PCM/JSON downloads from the SD corpus.
		The panel never exposes a general filesystem path.

config CONTEST2026_113_LAN_PANEL_KWS_ROOT
	string "KWS corpus root"
	default "/sdcard/kws_corpus"

config CONTEST2026_113_LAN_PANEL_AUTH_PATH
	string "Panel bearer token path"
	default "/data/panel.auth"

endif # CONTEST2026_113_LAN_PANEL
```

## app/routine_manager/Kconfig
```kconfig
#
# Contest 2026 team 113 desktop routine manager
#

menuconfig CONTEST2026_113_ROUTINE_MANAGER
	bool "Contest 2026 team 113 desktop routine manager"
	default n
	depends on GRAPHICS_LVGL
	depends on LV_USE_NUTTX
	depends on VIDEO_FB
	depends on LV_USE_CHART
	depends on LV_USE_LABEL
	depends on LV_USE_BUTTON
	depends on LV_USE_MSGBOX
	---help---
		Enable the LVGL desktop environment and routine manager.
		It supports /dev/fb0, /dev/input0, interactive schedules, and an
		optional TWI3 environment monitor. Audio and voice are not required.

if CONTEST2026_113_ROUTINE_MANAGER

config ROUTINE_MANAGER_PROGNAME
	string "Routine manager program name"
	default "routine_mgr"

config ROUTINE_MANAGER_PRIORITY
	int "Routine manager task priority"
	default 100

config ROUTINE_MANAGER_STACKSIZE
	int "Routine manager task stack size"
	default 40960

config ROUTINE_MANAGER_FONT_PATH
	string "Chinese UI LVGL binary font path"
	default "/etc/fonts/font_puhui_20_4.bin"
	---help---
		Binary font used by the default Chinese interface. The application
		uses built-in LVGL fonts when --english or --ascii is selected.

config ROUTINE_MANAGER_DEMO_RATE
	int "Demo real seconds per simulated hour"
	range 1 60
	default 5
	---help---
		Acceleration used only by routine_mgr --demo. Live mode follows the
		local wall clock and does not use this value.

config ROUTINE_MANAGER_UTC_OFFSET_MINUTES
	int "Civil time offset from UTC in minutes"
	range -720 840
	default 480
	---help---
		Offset used to convert the UTC system clock into the civil time shown
		by the UI and used for schedules. The DshanPi default is UTC+8.

config ROUTINE_MANAGER_ENVMON
	bool "TWI3 SHT40/BH1750/SGP30 environment monitor"
	default y
	depends on I2C_DRIVER
	depends on !DISABLE_PTHREAD

if ROUTINE_MANAGER_ENVMON

config ROUTINE_MANAGER_I2C_PATH
	string "Environment monitor I2C device"
	default "/dev/i2c3"

config ROUTINE_MANAGER_ENV_PRIORITY
	int "Environment worker priority"
	default 90

config ROUTINE_MANAGER_ENV_STACKSIZE
	int "Environment worker stack size"
	default 4096

endif # ROUTINE_MANAGER_ENVMON

config ROUTINE_MANAGER_VOICE
	bool "DMIC voice interaction demo"
	default y
	depends on SYSTEM_NXPLAYER
	depends on SYSTEM_NXRECORDER
	depends on !DISABLE_PTHREAD
	---help---
		Enable the non-blocking DMIC capture and Codec playback service. The
		first-stage recognizer detects speech activity but does not verify the
		spoken command semantics; the interface labels this limitation.

if ROUTINE_MANAGER_VOICE

config ROUTINE_MANAGER_VOICE_PRIORITY
	int "Voice worker priority"
	default 90

config ROUTINE_MANAGER_VOICE_STACKSIZE
	int "Voice worker stack size"
	default 32768

config ROUTINE_MANAGER_VOICE_CAPTURE_DEVICE
	string "DMIC capture device"
	default "/dev/audio/pcm1c"

config ROUTINE_MANAGER_VOICE_PLAYBACK_DEVICE
	string "Codec playback device"
	default "/dev/audio/pcm0p"

config ROUTINE_MANAGER_VOICE_RECORD_MS
	int "Maximum recording time in milliseconds"
	range 1000 10000
	default 3500

config ROUTINE_MANAGER_VOICE_VOLUME
	int "Playback volume percentage"
	range 1 100
	default 100

config ROUTINE_MANAGER_VOICE_ASSET_DIR
	string "Voice prompt asset directory"
	default "/etc/routine_voice"

config ROUTINE_MANAGER_KWS
	bool "Offline INT8 wake and environment-query recognition"
	default n
	depends on TFLITEMICRO
	---help---
		Run the accepted seven-class TensorFlow Lite Micro model after DMIC
		capture. It recognizes the Chinese wake phrase and four environment
		queries; unrelated speech and background are rejected. The current
		model is a one-speaker personal prototype.

config ROUTINE_MANAGER_KWS_CAPTURE
	bool "R528 DMIC keyword corpus capture mode"
	default y
	depends on SYSTEM_NXRECORDER
	---help---
		Enable routine_mgr --kws-capture. This early-exit mode records labeled
		16 kHz mono PCM samples under the FAT32 micro-SD mount without starting
		LVGL, environment services, playback, or the demo recognizer.

if ROUTINE_MANAGER_KWS_CAPTURE

config ROUTINE_MANAGER_KWS_CAPTURE_ROOT
	string "Keyword corpus storage root"
	default "/sdcard/kws_corpus"
	help
		KWS samples are stored on the FAT32 micro-SD mount so the card can be
		read directly by a host computer. Capture fails if the SD mount is not
		ready; it never falls back to internal /data storage.

config ROUTINE_MANAGER_KWS_STORAGE_MOUNT
	string "Keyword corpus storage mount point"
	default "/sdcard"
	help
		Mount point provided by the R528 Micro-TF automounter.

config ROUTINE_MANAGER_KWS_DEVICE_ID
	string "Anonymous board identifier for corpus files"
	default "r528a"

endif # ROUTINE_MANAGER_KWS_CAPTURE

endif # ROUTINE_MANAGER_VOICE

endif # CONTEST2026_113_ROUTINE_MANAGER
```

## app/st7796_test/Kconfig
```kconfig
config CONTEST2026_113_ST7796_TEST
	bool "Contest 2026 team 113 ST7796 framebuffer test"
	default n
	depends on VIDEO_FB && FB_UPDATE
	---help---
		Enable the ST7796U2 framebuffer metadata, color, corner, and
		partial-update validation command.
```

## app/wifi_manager/Kconfig
```kconfig
#
# Contest 2026 team 113 Wi-Fi manager
#

menuconfig CONTEST2026_113_WIFI_MANAGER
	bool "Contest 2026 team 113 Wi-Fi manager"
	default n
	depends on NETUTILS_NETLIB
	depends on WIRELESS_WAPI
	depends on LIBC_NETDB
	---help---
		Enable the contest Wi-Fi manager. It waits quietly while
		/data/wifi.cfg is absent and connects when valid credentials appear.

if CONTEST2026_113_WIFI_MANAGER

config CONTEST2026_113_WIFI_MANAGER_PRIORITY
	int "Wi-Fi manager task priority"
	default 100

config CONTEST2026_113_WIFI_MANAGER_STACKSIZE
	int "Wi-Fi manager stack size"
	default 20480

endif # CONTEST2026_113_WIFI_MANAGER
```

## board/r528s3-dshanpi/Kconfig
```kconfig
#
# For a description of the syntax of this configuration file,
# see the file kconfig-language.txt in the NuttX tools repository.
#

# The contest board is a custom board, so it does not inherit the vendor
# board-driver Kconfig through the normal boards/<arch>/<chip>/drivers link.
source "$BINDIR/../vendor/allwinnertech/boards/r528/drivers/micro_sd/Kconfig"
source "$BINDIR/../vendor/allwinnertech/boards/r528/drivers/realtek_ieee80211/Kconfig"

config ARCH_BOARD_R528S3_DSHANPI
	bool "r528 dshanpi"
	depends on ARCH_CHIP_R528
	select ARCH_HAVE_LEDS
	select ARCH_HAVE_BUTTONS
	select ARCH_HAVE_IRQBUTTONS
	select ARCH_HAVE_TRUSTZONE if X4B_AP || X4B_TEE
	select MICRO_TF
	---help---
		Enable board support for the Allwinner R528S3-based dshanpi
		board configuration.

config ARCH_BOARD_PARTITION_TABLE
        string "board partition table path"
        default ""
        ---help---
                This is a path for the board.

choice
prompt "choose system fucntion"

config DSHANPI_NSH
	bool "Enable the NSH fucntion on the 'DSHANPI' board"

endchoice

config R528_ST7796
	bool "320x480 SPI LCD"
	default n
	select LCD
	select LCD_FRAMEBUFFER
	select VIDEO_FB
	select FB_UPDATE
	select SPI
	select SPI_EXCHANGE
	select SPI_DRIVER
	select R528_SPI1
	---help---
		Enable the 320x480 ST7796U2 panel on the DshanPi LCD connector.
		The driver exposes a 480x320 RGB565 framebuffer through the NuttX
		LCD framebuffer bridge.

if R528_ST7796

config R528_ST7796_SOFTSPI
	bool "Use GPIO software SPI"
	default n
	---help---
		Use GPIO bit-banging for transport diagnostics.  The default uses the
		hardware SPI1 path that previously drove this physical panel.

config R528_ST7796_SPI_FREQUENCY
	int "Hardware SPI frequency"
	depends on !R528_ST7796_SOFTSPI
	range 100000 40000000
	default 8000000

config R528_ST7796_CS_PIN
	int "Port D chip-select pin"
	range 0 22
	default 10

config R528_ST7796_SCK_PIN
	int "Port D clock pin"
	range 0 22
	default 11

config R528_ST7796_MOSI_PIN
	int "Port D MOSI pin"
	range 0 22
	default 12

config R528_ST7796_DC_PIN
	int "Port D data/command pin"
	range 0 22
	default 14

config R528_ST7796_RESET_PIN
	int "Port D reset pin"
	range 0 22
	default 15

config R528_ST7796_BACKLIGHT_PIN
	int "Port D backlight pin"
	range 0 22
	default 16

config R528_ST7796_BACKLIGHT_ACTIVE_LOW
	bool "Backlight is active low"
	default n

config R528_ST7796_SOFTSPI_DELAY_US
	int "Software SPI half-cycle delay in microseconds"
	range 1 100
	default 1

config R528_ST7796_MADCTL
	hex "LCD MADCTL value"
	range 0x00 0xff
	default 0xe8
	---help---
		Select 480x320 landscape using MY, MX, MV, and BGR.  This orientation
		was determined from the physical four-corner color test.

endif # R528_ST7796
```
